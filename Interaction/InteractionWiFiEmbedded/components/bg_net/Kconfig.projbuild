## Interaction/InteractionWiFiEmbedded/components/bg_net/Kconfig.projbuild
```kconfig
menu "Net Connection Configuration"

    menu "WiFi Networks"

        config WIFI_SSID_1
            string "WiFi SSID 1"
            default ""
            help
                SSID (network name)  to connect to.

        config WIFI_PASSWORD_1
            string "WiFi Password 1"
            default ""
            help
                WiFi password (WPA or WPA2) to use.

        config WIFI_SSID_2
            string "WiFi SSID 2"
            default ""
            help
                SSID (network name)  to connect to.

        config WIFI_PASSWORD_2
            string "WiFi Password 2"
            default ""
            help
                WiFi password (WPA or WPA2) to use.

        config WIFI_SSID_3
            string "WiFi SSID 3"
            default ""
            help
                SSID (network name)  to connect to.

        config WIFI_PASSWORD_3
            string "WiFi Password 3"
            default ""
            help
                WiFi password (WPA or WPA2) to use.

    endmenu

    config WIFI_SCAN_LIST_SIZE
        int "Max size of scan list"
        range 0 20
        default 10
        help
            The size of array that will be used to retrieve the list of access points.

    config WIFI_SCAN_MAX_RETRY
        int "Max scan retry"
        default 3
        help
            Set maximum number of trys to scan for the above list of networks; in case
            we can't find it

    config WIFI_CONN_MAX_RETRY
        int "Max connection retry"
        default 6
        help
            Set the Maximum retry to avoid station reconnecting to the AP unlimited,
            in case the AP is really inexistent.

    choice WIFI_SCAN_METHOD
        prompt "WiFi Scan Method"
        default WIFI_SCAN_METHOD_ALL_CHANNEL
        help
            WiFi scan method:

            If "Fast" is selected, scan will end after find SSID match AP.

            If "All Channel" is selected, scan will end after scan all the channel.

        config WIFI_SCAN_METHOD_FAST
            bool "Fast"
        config WIFI_SCAN_METHOD_ALL_CHANNEL
            bool "All Channel"
    endchoice

    menu "WiFi Scan threshold"
        config WIFI_SCAN_RSSI_THRESHOLD
            int "WiFi minimum rssi"
            range -127 0

            default -127
            help
                The minimum rssi to accept in the scan mode.

        choice WIFI_SCAN_AUTH_MODE_THRESHOLD
            prompt "WiFi Scan auth mode threshold"
            default WIFI_AUTH_OPEN
            help
                The weakest authmode to accept in the scan mode.

            config WIFI_AUTH_OPEN
                bool "OPEN"
            config WIFI_AUTH_WEP
                bool "WEP"
            config WIFI_AUTH_WPA_PSK
                bool "WPA PSK"
            config WIFI_AUTH_WPA2_PSK
                bool "WPA2 PSK"
            config WIFI_AUTH_WPA_WPA2_PSK
                bool "WPA WPA2 PSK"
            config WIFI_AUTH_WPA2_ENTERPRISE
                bool "WPA2 ENTERPRISE"
            config WIFI_AUTH_WPA3_PSK
                bool "WPA3 PSK"
            config WIFI_AUTH_WPA2_WPA3_PSK
                bool "WPA2 WPA3 PSK"
            config WIFI_AUTH_WAPI_PSK
                bool "WAPI PSK"
        endchoice
    endmenu

    choice WIFI_CONNECT_AP_SORT_METHOD
        prompt "WiFi Connect AP Sort Method"
        default WIFI_CONNECT_AP_BY_SIGNAL
        help
            WiFi connect AP sort method:

            If "Signal" is selected, Sort matched APs in scan list by RSSI.

            If "Security" is selected, Sort matched APs in scan list by security mode.

        config WIFI_CONNECT_AP_BY_SIGNAL
            bool "Signal"
        config WIFI_CONNECT_AP_BY_SECURITY
            bool "Security"
    endchoice

endmenu
```
